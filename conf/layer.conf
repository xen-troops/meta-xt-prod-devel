## conf/layer.conf
```bitbake
# We have a conf and classes directory, add to BBPATH
BBPATH =. "${LAYERDIR}:"

# We have recipes-* directories, add to BBFILES
BBFILES += "${LAYERDIR}/recipes-*/*/*.bb \
            ${LAYERDIR}/recipes-*/*/*.bbappend"

BBFILE_COLLECTIONS += "meta-xt-products"
BBFILE_PATTERN_meta-xt-products = "^${LAYERDIR}/"
BBFILE_PRIORITY_meta-xt-products = "6"
```

## doc/conf/bblayers.conf
```bitbake
BBPATH = "${TOPDIR}"
BBFILES ?= ""

BBLAYERS ?= " \
  ${TOPDIR}/../xt-distro/meta \
  ${TOPDIR}/../meta-xt-images \
  ${TOPDIR}/../meta-xt-products \
  "
```

## recipes-dom0/dom0-image-rescue-initramfs/files/meta-xt-prod-extra/recipes-core/images/core-image-rescue-initramfs.wks
```
part /boot --source bootimg-partition --fstype=ext4 --label boot --active --align 1 --size 64
```

## recipes-dom0/dom0-image-thin-initramfs/files/meta-xt-prod-extra/wic/prod-devel.wks
```
# short-description: Create SD card image with a boot partition
# long-description:
# Create an image that can be written onto a SD card using dd for use
# with i.MX SoC family
# It uses u-boot + other binaries gathered together on imx-boot file
#
part / --source rootfs --rootfs-dir=rootfs_boot --ondisk mmcblk --fstype=vfat --label kernel --active --align 16384 --size 32
part --source rawcopy --sourceparams=file="domd.ext4" --ondisk mmcblk --fstype=ext4 --label domd --align 8192 --size 2G

bootloader --ptable msdos
```

## recipes-dom0/dom0-image-weston/files/meta-xt-extra/conf/layer.conf
```bitbake
# We have a conf and classes directory, add to BBPATH
BBPATH =. "${LAYERDIR}:"

# We have recipes-* directories, add to BBFILES
BBFILES += "${LAYERDIR}/recipes-*/*/*.bb \
            ${LAYERDIR}/recipes-*/*/*.bbappend"

BBFILE_COLLECTIONS += "meta-xt-extra"
BBFILE_PATTERN_meta-xt-extra := "^${LAYERDIR}/"
BBFILE_PRIORITY_meta-xt-extra = "6"
```

## recipes-domu/domu-image-litmusrt/files/meta-xt-prod-extra/conf/layer.conf
```bitbake
# We have a conf and classes directory, add to BBPATH
BBPATH =. "${LAYERDIR}:"

# We have recipes-* directories, add to BBFILES
BBFILES += "${LAYERDIR}/recipes-*/*/*.bb \
            ${LAYERDIR}/recipes-*/*/*.bbappend"

BBFILE_COLLECTIONS += "meta-xt-prod-extra"
BBFILE_PATTERN_meta-xt-prod-extra := "^${LAYERDIR}/"
BBFILE_PRIORITY_meta-xt-prod-extra = "6"
```

## recipes-domx/meta-xt-prod-domx/conf/layer.conf
```bitbake
# We have a conf and classes directory, add to BBPATH
BBPATH =. "${LAYERDIR}:"

BBFILE_COLLECTIONS += "meta-xt-prod-domx"
BBFILE_PATTERN_meta-xt-prod-domx = "^${LAYERDIR}/"
BBFILE_PRIORITY_meta-xt-prod-domx = "6"

LAYERSERIES_COMPAT_meta-xt-prod-domx = "sumo thud zeus dunfell"
```
