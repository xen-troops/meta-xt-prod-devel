/*
 * Device Tree Source for the Salvator-XS board
 * running XEN hypervisor
 *
 * Copyright (C) 2015 Renesas Electronics Corp.
 *
 * This file is licensed under the terms of the GNU General Public License
 * version 2.  This program is licensed "as is" without any warranty of any
 * kind, whether express or implied.
 */

#include "r8a7795-salvator-xs-4x2g-dom0.dts"

/ {
	model = "Renesas Salvator-XS board based on r8a7795 ES3.0 2x2G";

	memory@48000000 {
		device_type = "memory";
		/* first 128MB is reserved for secure area. */
		reg = <0x0 0x48000000 0x0 0x78000000>,
			  <0x5 0x00000000 0x0 0x80000000>,
	};
};
